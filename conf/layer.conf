## conf/layer.conf
```bitbake
# We have a conf and classes directory, add to BBPATH
BBPATH .= ":${LAYERDIR}"

# We have recipes-* directories, add to BBFILES
BBFILES += "${LAYERDIR}/recipes-*/*/*.bb \
            ${LAYERDIR}/recipes-*/*/*.bbappend"

BBFILE_COLLECTIONS += "meta-blue-bsp"
BBFILE_PATTERN_meta-blue-bsp = "^${LAYERDIR}/"
BBFILE_PRIORITY_meta-blue-bsp = "6"

LAYERDEPENDS_meta-blue-bsp = "core meta-arm meta-ti-bsp"
LAYERSERIES_COMPAT_meta-blue-bsp = "whinlatter scarthgap"
```

## conf/machine/beaglebone-blue.conf
```bitbake
#@TYPE: Machine
#@NAME: BeagleBone Blue (Custom)
#@DESCRIPTION: Custom lightweight configuration for the BB Blue robotics board

# =========================================================================
# 1. Architecture & Hardware Definition
# =========================================================================
# Inherit the base AM335x SoC architecture from the TI BSP layer
require conf/machine/include/ti33x.inc

# Define hardware capabilities (Removed display/touchscreen, kept networking & USB)
MACHINE_FEATURES = "apm usbgadget usbhost vfat ext2 wifi bluetooth alsa"

# Install proprietary TI firmware for the WL1835MOD Wi-Fi/Bluetooth chip
MACHINE_EXTRA_RRECOMMENDS = "linux-firmware-wl18xx"

# Include robotics sensor drivers and demo app
MACHINE_EXTRA_RRECOMMENDS += "blue-sensors-mod blue-sensor-demo"

# =========================================================================
# 2. Kernel & Device Tree
# =========================================================================
# Specify the custom device tree binary to be compiled by the kernel
KERNEL_DEVICETREE_PREFIX = ""
KERNEL_DEVICETREE = "ti/omap/custom-blue.dtb"

# =========================================================================
# 3. Image & Storage Configuration
# =========================================================================
# Build standard ext4 compressed archives and a flashable WIC image
IMAGE_FSTYPES += "tar.xz wic.xz"

# Use the standard SD/eMMC boot partition layout
WKS_FILE = "sdimage-bootpart.wks"

# =========================================================================
# 4. Console & Bootloader (U-Boot/Extlinux)
# =========================================================================
# Tell the Yocto build system which serial port to listen to
SERIAL_CONSOLES = "115200;ttyS0"

# Enable Extlinux boot automation
UBOOT_EXTLINUX = "1"

# SD Card path
UBOOT_EXTLINUX_ROOT = "root=/dev/mmcblk0p2"

# Point Extlinux to the custom device tree binary
UBOOT_EXTLINUX_FDT = "../custom-blue.dtb"

# earlycon pins the raw UART0 hardware address for pre-driver output.
# After drivers load, the kernel uses stdout-path="serial0" from the DTB
# to find UART0's ttyS slot (now ttyS5 with NR_UARTS=6) automatically.
# console=ttyS0 now works: with NR_UARTS=6, UART0 gets slot 0 (ttyS0) as expected.
UBOOT_EXTLINUX_CONSOLE = "console=ttyS0,115200n8"
UBOOT_EXTLINUX_KERNEL_ARGS = "rootwait rw earlycon=ns16550a,mmio32,0x44e09000"
```
